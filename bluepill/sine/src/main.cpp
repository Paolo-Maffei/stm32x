// Adapted from embello/explore/1446-lpc810/sine/ - 2018-10-29
//
// Generate a 50 Hz sine wave on pin PB12 of the STM32F103.
// See http://jeelabs.org/2014/11/19/getting-started-episode-3/
//
// Needs a 1 KOhm + 1 uF RC filter to convert PWM to an analog value.
//
// The 1-bit sigma-delta DAC synthesis was adapted from code by Jan Ostman,
// see http://www.hackster.io/janost/micro-virtual-analog-synthesizer

#include <jee.h>

PinB<12> speaker;

// Generated by gensine.go: [0,90) degrees, 256 steps, 16-bit
static uint16_t sineTable [256] = {
    0,201,402,603,804,1005,1206,1407,1608,1809,2009,2210,2411,2611,2811,3012,
    3212,3412,3612,3812,4011,4211,4410,4609,4808,5007,5205,5404,5602,5800,5998,
    6195,6393,6590,6787,6983,7180,7376,7571,7767,7962,8157,8351,8546,8740,8933,
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    32753,32758,32762,32766,32767,
};

int phase;  // signal phase: bits 0..7 are step, bits 8..9 are quadrant
int err;    // accumulator for 1-bit DAC error

int main() {
	speaker.mode(Pinmode::out);

    enableClkAt72MHz();
    enableSysTick(72);

    VTableRam().systick = []() {
        // about 20 us have passed, time to generate the next step
        uint8_t step = ++phase;
        // inverted offset in 2nd and 4th quadrant
        if (phase & (1<<8))
            step = ~step; // 0..255 -> 255..0
        // look up the sine value, table only has data for first quadrant
        int ampl = sineTable[step];
        // negative amplitude in 3rd and 4th quadrant
        if (phase & (1<<9))
            ampl = - ampl;
        // calculate the error, this evens out over time
        err = (uint16_t) err - (1<<15) - ampl;
        // set pin 3 if dac > err, else clear pin 3
        speaker = err >> 16;
    };
    
    while (1)
        __asm("wfi");
}
